## target/linux/r6200v2/Config.in
```kconfig
config TARGET_LINUX_GIT_TREEISH
	string
	prompt "treeish of linux git repository"
	depends on TARGET_r6200v2
	default "Please Input a Valid Treeish"
	help
           Input the treeish of linux git repository which you want to build

config TARGET_LINUX_GIT_REPOSITORY
	string
	prompt "name of linux repository"
	depends on TARGET_r6200v2
	default "linux.git"
	help
	  input the name of linux repository which you want to build

config TARGET_LINUX_GIT_URL
	string
	prompt "url of linux repository"
	depends on TARGET_r6200v2
	default "ssh://dniserver/home/jonathan/linux.git"
	help
	  input the url of linux repository which you want to build

config TARGET_NETFILTER_GIT_TREEISH
	string
	prompt "treeish of netfilter git repository"
	depends on TARGET_r6200v2
	default "Please Input a Valid Treeish"
	help
           Input the treeish of netfilter git repository which you want to build

config TARGET_NETFILTER_GIT_REPOSITORY
	string
	prompt "name of netfilter repository"
	depends on TARGET_r6200v2
	default "dni-netfilter.git"
	help
	  input the name of netfilter repository which you want to build

config TARGET_NETFILTER_GIT_URL
	string
	prompt "url of netfilter repository"
	depends on TARGET_r6200v2
	default "ssh://dniserver/home/jonathan/dni-netfilter.git"
	help
	  input the url of netfilter repository which you want to build

config LSDK_TREEISH
	string
	prompt "treeish of broadcom lsdk git repository"
	depends on TARGET_r6200v2
	default "Please Input a Valid Treeish"
	help
           Input the treeish of netfilter git repository which you want to build

config TARGET_LSDK_GIT_REPOSITORY
	string
	prompt "name of LSDK repository"
	depends on TARGET_r6200v2
	default "brcm_sdk.git"
	help
	  input the name of LSDK repository which you want to build

config TARGET_LSDK_GIT_URL
	string
	prompt "url of lsdk repository"
	depends on TARGET_r6200v2
	default "ssh://dniserver/home/jonathan/brcm_sdk.git"
	help
	  input the url of lsdk repository which you want to build
```

## target/linux/r6200v2/image/Config.in
```kconfig
config TARGET_MODELNAME
    string "Define the model name for r6200v2"
    depends TARGET_r6200v2
    default "r6200v2"

config TARGET_BOARD_HW_ID
    string "Define the board hw id for r6200v2"
    depends TARGET_r6200v2
    default "2976436100+128+128"

config TARGET_FW_VERSION
    string "Define the firmware version"
    depends TARGET_r6200v2
    default "V0.0.0.1"

config TARGET_LG_VERSION
    string "Define the language table version"
    depends TARGET_r6200v2
    default "V1.0.0.117"

config TARGET_MAGIC_NUMBER
    string "Define the magic number for the firmware"
    depends TARGET_r6200v2
    default "0x36323030"

config TARGET_HEAD_LENGTH
    string "Define the length of r6200v2's firmware header."
    depends TARGET_r6200v2
    default "128"

config TARGET_KERNEL_SIZE
    string "Define the kernel size of r6200v2's firmware"
    depends TARGET_r6200v2
    default "1152k"

config TARGET_MAX_KERNEL_SIZE
    string "Define the max kernel size of r6200v2's firmware"
    depends TARGET_r6200v2
    default "1179648"

config TARGET_MAX_IMAGE_SIZE
    string "Define the max image size of r6200v2's firmware"
    depends TARGET_r6200v2
    default "25034752"
```

## target/linux/wm2500rp/Config.in
```kconfig
config TARGET_LINUX_GIT_TREEISH
	string
	prompt "treeish of linux git repository"
	depends on TARGET_wm2500rp
	default "linux-v2.6.31-dni13"
	help
           Input the treeish of linux git repository which you want to build

config TARGET_LINUX_GIT_REPOSITORY
	string
	prompt "name of linux git repository"
	depends on TARGET_wm2500rp
	default "linux-2.6.git"
	help
	   Input the name of linux git repository which you want to build

config TARGET_LINUX_GIT_URL
	string
	prompt "URL of linux git repository"
	depends on TARGET_wm2500rp
	default "ssh://dniserver/scm/dnigit/taipei-clones/linux-2.6.git"
	help
	   Input the url of linux git repository which you want to build

config TARGET_NETFILTER_GIT_TREEISH
	string
	prompt "treeish of netfilter git repository"
	depends on TARGET_wm2500rp
	default "netfilter-v2.6.31-dni13"
	help
           Input the treeish of netfilter git repository which you want to build

config TARGET_NETFILTER_GIT_REPOSITORY
	string
	prompt "name of netfilter git repository"
	depends on TARGET_wm2500rp
	default "dni-netfilter.git"
	help
	   Input the name of netfilter git repository which you want to build

config TARGET_NETFILTER_GIT_URL
	string
	prompt "url of netfilter git repository"
	depends on TARGET_wm2500rp
	default "ssh://dniserver/scm/dnigit/taipei-clones/dni-netfilter.git"
	help
	   Input the url of netfilter git repository which you want to build

config TARGET_MAGIC_NUMBER
	string
	prompt "define the magic number for the target"
	depends on TARGET_wm2500rp
	default "0x33373034"
	help
	   Input the magic number for wm2500rp
```

## target/linux/wm2500rp/image/Config.in
```kconfig
config TARGET_MODELNAME
    string "Define the model name for wm2500rp"
    depends TARGET_wm2500rp
    default "WM2500RP"

config TARGET_BOARD_HW_ID
    string "Define the board hw id for wm2500rp"
    depends TARGET_wm2500rp
    default "29763948+128+128"

config TARGET_FW_VERSION
    string "Define the firmware version"
    depends TARGET_wm2500rp
    default "V1.0.1.32"

config TARGET_LG_VERSION
    string "Define the language table version"
    depends TARGET_wm2500rp
    default "V1.0.0.119"

config TARGET_HEAD_LENGTH
    string "Define the length of wm2500rp's firmware header."
    depends TARGET_wm2500rp
    default "128"

config TARGET_KERNEL_SIZE
    string "Define the kernel size of wm2500rp's firmware"
    depends TARGET_wm2500rp
    default "1152k"

config TARGET_MAX_KERNEL_SIZE
    string "Define the max kernel size of wm2500rp's firmware"
    depends TARGET_wm2500rp
    default "1179648"

config TARGET_MAX_IMAGE_SIZE
    string "Define the max image size of wm2500rp's firmware"
    depends TARGET_wm2500rp
    default "25034752"
```

## target/linux/wndr3400v3/Config.in
```kconfig
config TARGET_LINUX_GIT_TREEISH
	string
	prompt "treeish of linux git repository"
	depends on TARGET_wndr3400v3
	default "linux-v2.6.31-dni13"
	help
           Input the treeish of linux git repository which you want to build

config TARGET_LINUX_GIT_REPOSITORY
	string
	prompt "name of linux git repository"
	depends on TARGET_wndr3400v3
	default "linux-2.6.git"
	help
	   Input the name of linux git repository which you want to build

config TARGET_LINUX_GIT_URL
	string
	prompt "URL of linux git repository"
	depends on TARGET_wndr3400v3
	default "ssh://dniserver/scm/dnigit/taipei-clones/linux-2.6.git"
	help
	   Input the url of linux git repository which you want to build

config TARGET_NETFILTER_GIT_TREEISH
	string
	prompt "treeish of netfilter git repository"
	depends on TARGET_wndr3400v3
	default "netfilter-v2.6.31-dni13"
	help
           Input the treeish of netfilter git repository which you want to build

config TARGET_NETFILTER_GIT_REPOSITORY
	string
	prompt "name of netfilter git repository"
	depends on TARGET_wndr3400v3
	default "dni-netfilter.git"
	help
	   Input the name of netfilter git repository which you want to build

config TARGET_NETFILTER_GIT_URL
	string
	prompt "url of netfilter git repository"
	depends on TARGET_wndr3400v3
	default "ssh://dniserver/scm/dnigit/taipei-clones/dni-netfilter.git"
	help
	   Input the url of netfilter git repository which you want to build
```

## target/linux/wndr3400v3/image/Config.in
```kconfig
config TARGET_MODELNAME
    string "Define the model name for wndr3400v3"
    depends TARGET_wndr3400v3
    default "WNDR3400v3"

config TARGET_BOARD_HW_ID
    string "Define the board hw id for wndr3400v3"
    depends TARGET_wndr3400v3
    default "29764037+8+64"

config TARGET_FW_VERSION
    string "Define the firmware version"
    depends TARGET_wndr3400v3
    default "V1.0.0.12"

config TARGET_LG_VERSION
    string "Define the language table version"
    depends TARGET_wndr3400v3
    default "V1.0.0.104"

config TARGET_MAGIC_NUMBER
    string
    prompt "define the magic number for the target"
    depends on TARGET_wndr3400v3
    default "0x33343033"

config TARGET_HEAD_LENGTH
    string "Define the length of wndr3400v3's firmware header."
    depends TARGET_wndr3400v3
    default "128"

config TARGET_KERNEL_SIZE
    string "Define the kernel size of wndr3400v3's firmware"
    depends TARGET_wndr3400v3
    default "1152k"

config TARGET_MAX_KERNEL_SIZE
    string "Define the max kernel size of wndr3400v3's firmware"
    depends TARGET_wndr3400v3
    default "1179648"

config TARGET_MAX_IMAGE_SIZE
    string "Define the max image size of wndr3400v3's firmware"
    depends TARGET_wndr3400v3
    default "25034752"
```

## target/linux/wndr3700v4/Config.in
```kconfig
config TARGET_LINUX_GIT_TREEISH
	string
	prompt "treeish of linux git repository"
	depends on TARGET_wndr3700v4
	default "linux-v2.6.31-dni13"
	help
           Input the treeish of linux git repository which you want to build

config TARGET_LINUX_GIT_REPOSITORY
	string
	prompt "name of linux git repository"
	depends on TARGET_wndr3700v4
	default "linux-2.6.git"
	help
	   Input the name of linux git repository which you want to build

config TARGET_LINUX_GIT_URL
	string
	prompt "URL of linux git repository"
	depends on TARGET_wndr3700v4
	default "ssh://dniserver/scm/dnigit/taipei-clones/linux-2.6.git"
	help
	   Input the url of linux git repository which you want to build

config TARGET_NETFILTER_GIT_TREEISH
	string
	prompt "treeish of netfilter git repository"
	depends on TARGET_wndr3700v4
	default "netfilter-v2.6.31-dni13"
	help
           Input the treeish of netfilter git repository which you want to build

config TARGET_NETFILTER_GIT_REPOSITORY
	string
	prompt "name of netfilter git repository"
	depends on TARGET_wndr3700v4
	default "dni-netfilter.git"
	help
	   Input the name of netfilter git repository which you want to build

config TARGET_NETFILTER_GIT_URL
	string
	prompt "url of netfilter git repository"
	depends on TARGET_wndr3700v4
	default "ssh://dniserver/scm/dnigit/taipei-clones/dni-netfilter.git"
	help
	   Input the url of netfilter git repository which you want to build

config TARGET_MAGIC_NUMBER
	string
	prompt "define the magic number for the target"
	depends on TARGET_wndr3700v4
	default "0x33373034"
	help
	   Input the magic number for wndr3700v4
```

## target/linux/wndr3700v4/image/Config.in
```kconfig
config TARGET_MODELNAME
    string "Define the model name for wndr3700v4"
    depends TARGET_wndr3700v4
    default "WNDR3700v4"

config TARGET_BOARD_HW_ID
    string "Define the board hw id for wndr3700v4"
    depends TARGET_wndr3700v4
    default "29763948+128+128"

config TARGET_FW_VERSION
    string "Define the firmware version"
    depends TARGET_wndr3700v4
    default "V1.0.1.32"

config TARGET_LG_VERSION
    string "Define the language table version"
    depends TARGET_wndr3700v4
    default "V1.0.0.119"

config TARGET_HEAD_LENGTH
    string "Define the length of wndr3700v4's firmware header."
    depends TARGET_wndr3700v4
    default "128"

config TARGET_KERNEL_SIZE
    string "Define the kernel size of wndr3700v4's firmware"
    depends TARGET_wndr3700v4
    default "1152k"

config TARGET_MAX_KERNEL_SIZE
    string "Define the max kernel size of wndr3700v4's firmware"
    depends TARGET_wndr3700v4
    default "1179648"

config TARGET_MAX_IMAGE_SIZE
    string "Define the max image size of wndr3700v4's firmware"
    depends TARGET_wndr3700v4
    default "25034752"
```

## target/linux/x6200/Config.in
```kconfig
config TARGET_LINUX_GIT_TREEISH
	string
	prompt "treeish of linux git repository"
	depends on TARGET_x6200
	default "Please Input a Valid Treeish"
	help
           Input the treeish of linux git repository which you want to build

config TARGET_LINUX_GIT_REPOSITORY
	string
	prompt "name of linux git repository"
	depends on TARGET_x6200
	default "linux-2.6.22.git"
	help
	   Input the name of linux git repository which you want to build

config TARGET_LINUX_GIT_URL
	string
	prompt "url of linux git repository"
	depends on TARGET_x6200
	default "ssh://dniserver/scm/dnigit/openwrt-buildroot.git/alime.mao/kernel/linux-2.6.22.git"
	help
	   Input the url of linux git repository which you want to build

config TARGET_NETFILTER_GIT_TREEISH
	string
	prompt "treeish of netfilter git repository"
	depends on TARGET_x6200
	default "Please Input a Valid Treeish"
	help
           Input the treeish of netfilter git repository which you want to build

config TARGET_NETFILTER_GIT_REPOSITORY
	string
	prompt "name of netfilter git repository"
	depends on TARGET_x6200
	default "dni-netfilter-2.6.22.git"
	help
	   Input the name of netfilter git repository which you want to build

config TARGET_NETFILTER_GIT_URL
	string
	prompt "url of netfilter git repository"
	depends on TARGET_x6200
	default "ssh://dniserver/scm/dnigit/openwrt-buildroot.git/alime.mao/kernel/dni-netfilter-2.6.22.git"
	help
	   Input the url of netfilter git repository which you want to build

config LSDK_TREEISH
	string
	prompt "treeish of broadcom lsdk git repository"
	depends on TARGET_x6200
	default "Please Input a Valid Treeish"
	help
           Input the treeish of netfilter git repository which you want to build

config LSDK_REPOSITORY
	string
	prompt "name of broadcom lsdk git repository"
	depends on TARGET_x6200
	default "brcm_sdk.git"
	help
	   Input the name of netfilter git repository which you want to build

config LSDK_URL
	string
	prompt "url of broadcom lsdk git repository"
	depends on TARGET_x6200
	default "ssh://dniserver/home/jonathan/sdk/brcm_sdk.git"
	help
	   Input the url of netfilter git repository which you want to build
```

## target/linux/x6200/image/Config.in
```kconfig
config TARGET_MODELNAME
    string "Define the model name"
    depends TARGET_x6200
    default "x6200"

config TARGET_BOARD_HW_ID
    string "Define the board hw id"
    depends TARGET_x6200
    default "2976436100+128+128"

config TARGET_FW_VERSION
    string "Define the firmware version"
    depends TARGET_x6200
    default "V0.0.0.1"

config TARGET_LG_VERSION
    string "Define the language table version"
    depends TARGET_x6200
    default "V1.0.0.117"

config TARGET_MAGIC_NUMBER
    string "Define the magic number for the firmware"
    depends TARGET_x6200
    default "0x36323030"

config TARGET_HEAD_LENGTH
    string "Define the length of firmware header."
    depends TARGET_x6200
    default "128"

config TARGET_KERNEL_SIZE
    string "Define the kernel size of firmware"
    depends TARGET_x6200
    default "1152k"

config TARGET_MAX_KERNEL_SIZE
    string "Define the max kernel size of firmware"
    depends TARGET_x6200
    default "1179648"

config TARGET_MAX_IMAGE_SIZE
    string "Define the max image size of firmware"
    depends TARGET_x6200
    default "25034752"
```
