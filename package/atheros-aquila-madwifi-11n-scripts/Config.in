## package/atheros-aquila-madwifi-11n-scripts/Config.in
```kconfig
# MadWifi configuration

config ATHEROS_AQUILA_SCRIPT_GIT_TREEISH
	string
	prompt "treeish of atheros aquila script git repository"
	default "madwifi-11n-scripts-aquila-dni79"
	help
	  Input the treeish of atheros aquila git repository which you want to build

config ATHEROS_AQUILA_SCRIPT_GIT_REPOSITORY
	string
	prompt "name of atheros aquila script git repository"
	default "madwifi-11n-scripts.git"
	help
	  Input the name of atheros aquila git repository which you want to build

config ATHEROS_AQUILA_SCRIPT_GIT_URL
	string
	prompt "url of atheros aquila script git repository"
	default "ssh://dniserver/scm/dnigit/common/apps/madwifi-11n-scripts.git"
	help
	  Input the url of atheros aquila git repository which you want to build

choice
	prompt "Select the type of board type"
	default ATHEROS_AQUILA_SCRIPT_TYPE_DNI
	help
	  This option control the board type will be used by the script

config ATHEROS_AQUILA_SCRIPT_TYPE_DNI
	bool "Use DNI merged script type"
	help
          This is to use DNI merged script type

config ATHEROS_AQUILA_SCRIPT_TYPE_SINGLE
	bool "Use Atheros single board script"
	help
          This is to use Atheros Aquila single board script

config ATHEROS_AQUILA_SCRIPT_TYPE_DUAL
	bool "Use Atheros dual board script"
	help
          This is to use Atheros Aquila dual board script

endchoice

config ATHEROS_AQUILA_SCRIPT_USE_BOARD
       string "Designate Atheros platform which is used for this project"
       default ""
       help
         Different Atheros platform has different configuration file,
         so the Atheros platform must be designated for installing
         corresponding configuration file. If you don't know which
         Atheros platfrom should be used for your project, please
         contact with module administrator for more information.

config ATHEROS_AQUILA_SCRIPT_READONLY_FS
       bool "Is rootfs readonly?"
       default n
       help
        If rootfs is readonly, we need to copy Atheros scripts to another folder
        to link /etc/ath to ramdisk to ensure /etc/ath and /etc/wpa2 are writable.

choice
	prompt "Select the source of configuration system"
	default ATHEROS_AQUILA_SCRIPT_DNI_CONFIG
	help
	  This option control the source of configuration system

config ATHEROS_AQUILA_SCRIPT_DNI_CONFIG
	bool "Use DNI datalib configuration system"
	help
          This is to use DNI configuration system (datalib)

config ATHEROS_AQUILA_SCRIPT_OPENWRT_CONFIG
	bool "Use Openwrt configuration system"
	help
          This is to use Openwrt configuration system

endchoice

config ATHEROS_AQUILA_NUMBER_AHB
	string "The AHB number of this board"
	default "1"

config ATHEROS_AQUILA_PLATFORM_PATCH
       bool "Apply platform specific patch"
       default n

config ATHEROS_AQUILA_SCRIPT_WSC_MANUFACTURER
       string "The name of manufacturer used by WPS"
       default "none"

config ATHEROS_AQUILA_SCRIPT_WSC_MODEL_NAME
       string "The model name used by WPS"
       default "none"

config ATHEROS_AQUILA_SCRIPT_WSC_MODEL_NUMBER
       string "The model number used by WPS"
       default "none"

config ATHEROS_AQUILA_SCRIPT_NSS_11AC
       int "Number of Spatial Streams of 11AC interface "
       default 0
```

## package/atheros-aquila-madwifi/Config.in
```kconfig
# MadWifi configuration

config ATHEROS_MADWIFI_GIT_TREEISH
	string
	prompt "treeish of atheros madwifi git repository"
	default "madwifi-11n-aquila-dni39"
	help
           Input the treeish of atheros-aquila-madwifi git repository which you want to build

config ATHEROS_MADWIFI_GIT_REPOSITORY
	string
	prompt "name of atheros madwifi git repository"
	default "madwifi-11n.git"
	help
	   Input the name of atheros-aquila-madwifi git repository which you want to build

config ATHEROS_MADWIFI_GIT_URL
	string
	prompt "url of atheros madwifi git repository"
	default "ssh://dniserver/scm/dnigit/vendor/atheros/madwifi-11n/spencer/madwifi-11n.git"
	help
	   Input the url of atheros-aquila-madwifi git repository which you want to build

config ATHEROS_MADWIFI_SUPPORT_SPECTRAL
	bool "Enable Spectral and related tools"
	default n

config ATHEROS_MADWIFI_SUPPORT_DFS
	bool "Enable DFS"
	default n

config ATHEROS_MADWIFI_SUPPORT_MCAST_ENHANCEMENT
	bool "Enable IEEE80211 Multicast Enhancement"
	default y

config ATHEROS_MADWIFI_SUPPORT_SW_CRYPTO
	bool "Enable Software crypto"
	default y

config ATHEROS_MADWIFI_SUPPORT_BUILD_OPTIMIZED
	bool "Enable Building optimization"
	default y

config ATHEROS_MADWIFI_SUPPORT_HORNET
	bool "Support Atheros HORNET chip"
	default n

config ATHEROS_MADWIFI_SUPPORT_AR9300
	bool "Support Atheros AR9300 chip"
	default n

config ATHEROS_MADWIFI_SUPPORT_IQUE
	bool "Support Atheros iQueue feature"
	default y

config ATHEROS_MADWIFI_SUPPORT_IQUE_EXT
	bool "Support Atheros iQueue EXT feature"
	default y

config ATHEROS_MADWIFI_SUPPORT_PAPRD
	bool "Support Atheros PAPRD feature"
	default n

config ATHEROS_MADWIFI_NO_5G_SUPPORT
	bool "Disable 5G support"
	default y

config ATHEROS_MADWIFI_SUPPORT_PKTLOG
	bool "Enable Atheros packet log"
	default y

config ATHEROS_MADWIFI_SUPPORT_RPTPLACEMENT
	bool "Support repeater placement"
	default y

config ATHEROS_MADWIFI_RADIOS
       int "Number of RADIO"
       default 1

config ATHEROS_MADWIFI_CAL_LOCATIONS
       string "Calibration Address"
       default 0xbfff1000

config ATHEROS_MADWIFI_CAL_LOCATIONS_PCI
       string "Calibration Address for PCI"
       default 0xbfff1000

config ATHEROS_MADWIFI_CAL_LOCATIONS_AHB
       string "Calibration Address for AHB"
       default 0xbfff0000

config ATHEROS_MADWIFI_READ_2G_MAC_ADDR
       bool "Read 2.4G MAC address from specified location in flash"
       default n

config ATHEROS_MADWIFI_2G_MAC_ADDR_LOC
       string "Read 2.4G MAC address from ..."
       depends ATHEROS_MADWIFI_READ_2G_MAC_ADDR
       default 0xbfff1000

config ATHEROS_MADWIFI_READ_5G_MAC_ADDR
       bool "Read 5G MAC address from specified location in flash"
       default n

config ATHEROS_MADWIFI_5G_MAC_ADDR_LOC
       string "Read 5G MAC address from ..."
       depends ATHEROS_MADWIFI_READ_5G_MAC_ADDR
       default 0xbfff5000

config ATHEROS_NETGEAR_ACL
       bool "Support NetGear ACL"
       default n

config ATHEROS_MADWIFI_SUPPORT_VOWEXT
       bool "enable ATH_SUPPORT_VOWEXT"
       default n

config ATHEROS_MADWIFI_SUPPORT_VOW_EXT_STATS
       bool "enable ATH_VOW_EXT_STATS"
       default n

config ATHEROS_MADWIFI_SUPPORT_VOW_TIDSCHED
       bool "enable VOW_TIDSCHED"
       default n

config ATHEROS_MADWIFI_SUPPORT_VOW_LOGLATENCY
       bool "enable VOW_LOGLATENCY"
       default n

config ATHEROS_MADWIFI_SUPPORT_CFEND
       bool "enable ATH_SUPPORT_CFEND"
       default n

config ATHEROS_MADWIFI_SUPPORT_DESCFAST
       bool "enable ATH_SUPPORT_DESCFAST"
       default n

config ATHEROS_MADWIFI_SUPPORT_TDLS
       bool "enable ATH_SUPPORT_TDLS"
       default n

config ATHEROS_MADWIFI_SUPPORT_GREEN_AP
       bool "enable Green AP (ATH_SUPPORT_GREEN_AP)"
       default n

config ATHEROS_MADWIFI_SUPPORT_AR5416_INT_MITIGATION
       bool "enable ATH_SUPPORT_AR5416_INT_MITIGATION"
       default n

config ATHEROS_MADWIFI_SUPPORT_CAP_AMSDU
       bool "enable AMSDU capability (ATH_CAP_AMSDU)"
       default n

config ATHEROS_MADWIFI_SUPPORT_HOWL
       bool "enable HOWL support"
       default n

config ATHEROS_MADWIFI_PLATFORM_PATCH
       bool "Apply platform specific patch"
       default n

config ATHEROS_MADWIFI_RXBUF
       int "Number of receive buffer"
       default 512

config ATHEROS_MADWIFI_TXBUF
       int "Number of transmission buffer"
       default 512

config ATHEROS_MADWIFI_BUS_AS_DUAL
	bool "Set bus as dual"
	default y

config ATHEROS_MADWIFI_BUS_AS_AHB
	bool "Set bus as ahb"
	default n

config ATHEROS_MADWIFI_SYNC_WITH_DB120
	bool "sync with db120(LSDK: 9.2.0.1020)"
	default y

config ATHEROS_MADWIFI_USE_CLIENT_BRIDGE
	bool "Use client bridge feature"
	depends on PACKAGE_kmod-atheros-aquila-madwifi
	default n

config ATHEROS_MADWIFI_DISPLAY_SCAN_IN_PROC
	bool "Display scan result in proc system"
	depends on PACKAGE_kmod-atheros-aquila-madwifi
	default n
```

## package/atheros-aquila-wpa2/Config.in
```kconfig
# Atheros hostap configuration

config ATHEROS_AQUILA_WPA_GIT_TREEISH
	string
	prompt "treeish of atheros aquila wpa git repository"
	default "hostap-aquila-v0.8-dni27"
	help
          Input the treeish of atheros aquila wpa git repository which you want to build

config ATHEROS_AQUILA_WPA_GIT_REPOSITORY
	string
	prompt "name of atheros aquila wpa git repository"
	default "hostap.git"
	help
	  Input the name of atheros aquila wpa git repository which you want to build

config ATHEROS_AQUILA_WPA_GIT_URL
	string
	prompt "url of atheros aquila wpa git repository"
	default "ssh://dniserver/scm/dnigit/common/apps/hostap.git"
	help
	  Input the url of atheros aquila wpa git repository which you want to build

config ATHEROS_AWUILA_WPA_ATHR_DEFAULT_CONFIGURATION
	bool "Apply default configuration"
	default n

config ATHEROS_AQUILA_WPA_PLATFORM_PATCH
	bool "Apply platform specific patches"
	default n

config ATHEROS_AQUILA_WPA_ATHR_HOSTAP
	bool "Use Atheros latest hostap package"
	help
	  This is to use Atheros latest hostap package, which is derived
	  from the original hostap in w1.fi.

config ATHEROS_AQUILA_WPA_HOSTAPD
	default y
	bool "Install hostapd"

config ATHEROS_AQUILA_WPA_WPASUPPLICANT
	default n
	bool "Install wpa_supplicant"
```

## package/atheros-enet/Config.in
```kconfig
# Atheros ethernet driver configuration
config ATHEROS_ENET_GIT_TREEISH
	string
	prompt "treeish of atheros-enet git repository"
	default "atheros-enet-v9.2.0.1017-dni37"
	help
           Input the treeish of atheros-enet git repository which you want to build

config ATHEROS_ENET_GIT_REPOSITORY
	string
	prompt "name of atheros-enet git repository"
	default "atheros-enet.git"
	help
	   Input the name of atheros-enet git repository which you want to build

config ATHEROS_ENET_GIT_URL
	string
	prompt "url of atheros-enet git repository"
	default "ssh://dniserver/scm/dnigit/vendor/atheros/atheros-enet/vincent.yang/atheros-enet.git"
	help
	   Input the url of atheros-enet git repository which you want to build

config ATHEROS_ENET_BOARD
	string "Board that atheros-enet embedded"
	default "db120-wndr3700v4"
```

## package/cyassl/Config.in
```kconfig
config CYASSL_VERSION
	string
	default "1.4.0"			if CYASSL_VERSION_1_4_0
	default "1.6.5"			if CYASSL_VERSION_1_6_5

choice
	depends on PACKAGE_libcyassl
	prompt "Cyassl version"
	default CYASSL_VERSION_1_4_0

	config CYASSL_VERSION_1_4_0
		bool "CyaSSL 1.4.0"

	config CYASSL_VERSION_1_6_5
		bool "CyaSSL 1.6.5"
endchoice
```

## package/datalib/Config.in
```kconfig
# datalib configuration

config DNI_DATALIB_GIT_TREEISH
	string
	prompt "treeish of dni datalib git repository"
	default "datalib-dni3"
	help
          Input the treeish of dni datalib git repository which you want to build

config DNI_DATALIB_GIT_REPOSITORY
	string
	prompt "name of dni datalib git repository"
	default "datalib.git"
	help
	  Input the name of dni datalib git repository which you want to build

config DNI_DATALIB_GIT_URL
	string
	prompt "url of dni datalib git repository"
	default "ssh://dniserver/scm/dnigit/common/apps/datalib.git"
	help
	  Input the url of dni datalib git repository which you want to build

config DNI_DATALIB_PLATFORM_PATCH
	bool "Apply platform specific patches"
	default n

config DNI_DEFAULT_USER_CONFIGURATION
	bool "Use DNI default user configuration value"
	help
          This is to use DNI default user configuration value

config DATALIB_MAGIC
	string "Datalib Magic Number"
	default 0x20080724

config DATALIB_SPACE
	string "Datalib config space"
	default 0x20000

config DATALIB_NAME_SPACE
	string "Datalib name space"
	default 0x8000
```

## package/detcable/Config.in
```kconfig
# kmod-e2fs configuration
config DETCABLE_PLATFORM_PATCH
	bool "Apply platform specific patches"
	default n
```

## package/dni-cwmp/Config.in
```kconfig
config DNI_CWMP_GIT_TREEISH
	string
	prompt "treeish of cwmp git repository"
	default "c60d2c483024d77f3b900721fd9d0c63968be417"
	help
           Input the treeish of cwmp git repository which you want to build

config DNI_CWMP_GIT_REPOSITORY
	string
	prompt "name of cwmp git repository"
	default "cwmp.git"
	help
	   Input the name of cwmp git repository which you want to build

config DNI_CWMP_GIT_URL
	string
	prompt "url of cwmp git repository"
	default "ssh://dniserver/scm/dnigit/openwrt-buildroot.git/hardy.zhang/cwmp.git"
	help
	   Input the url of cwmp git repository which you want to build
```

## package/ebtables/Config.in
```kconfig
# kmod-e2fs configuration
config EBT_VERSION
	string
	prompt "ebtables version"
	default "2.0.9-1"

config EBT_MD5SUM
	string
	prompt "ebtables md5sum"
	default 0e0c20adf2bba6d91dbd0b74a1a38c33

config EBT_PLATFORM_PATCH
	bool "Apply platform specific patches"
	default n
```

## package/hotplug2/Config.in
```kconfig
# kmod-e2fs configuration
config HOTPLUG2_PLATFORM_FILES
	bool "Use platform files for hotplug"
	default n

config HOTPLUG2_PLATFORM_PATCHES
	bool "Use platform patches for hotplug"
	default n
```

## package/kernel/modules/Config.in
```kconfig
# kmod-pptp configuration
config PPP_GENERIC
	bool "if kernel support ppp_generic as module"
	default y

config PPP_SLHC
	bool "if kernel support slhc as module"
	default y
```

## package/led-control/Config.in
```kconfig
config LED_CONTROL_PLATFORM_SRC
	bool "Compile the Platorm LED Control Src Code"
	default n
```
