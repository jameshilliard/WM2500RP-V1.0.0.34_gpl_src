## package/miniupnpd/Config.in
```kconfig
config MINIUPNPD_GIT_TREEISH
	string
	prompt "treeish of miniupnpd git repository"
	default "miniupnpd-20070127-dni33"
	help
	  input the treeish of miniupnpd git repository which you want to build

config MINIUPNPD_GIT_REPOSITORY
	string
	prompt "name of miniupnpd git repository"
	default "miniupnpd.git"
	help
	  input the name of miniupnpd git repository which you want to build

config MINIUPNPD_GIT_URL
	string
	prompt "url of miniupnpd git repository"
	default "ssh://dniserver/scm/dnigit/common/apps/miniupnpd.git"
	help
	  input the url of miniupnpd git repository which you want to build

config MINIUPNPD_FRIENDLYNAME
	string
	prompt "Friendly name of the router"
	default "NETGEAR WNDR3700v4 Wireless Router"
	help
	  Friendly name of the router, such as NETGEAR WNDR3700v4 Wireless Router

config MINIUPNPD_MODELNAME
	string
	prompt "Model name of the route"
	default "RangeMax N300 Wireless Router"
	help
	  Model name of the router, such as RangeMax N300 Wireless Router

config MINIUPNPD_MODELNUMBER
	string
	prompt "Model number of the router"
	default "WNDR3700v4"
	help
	  Model number of the router, such as WNDR3700v4

config MINIUPNPD_MODELURL
	string
	prompt "Model url of the router"
	default "http://www.netgear.com/home/products/wirelessrouters"
	help
	  Model url of the router, such as http://www.netgear.com/home/products/wirelessrouters/simplesharing/WNR1000v4.aspx

config MINIUPNPD_SUPPORT_PNPX
	bool "Support Microsoft PnP-X function"
	default n
	help
	  Under Windows Vista and Windows 7, Plug and Play Extensions (PnP-X) allows network-connected
	  devices to be discovered and installed on a PC client as if they were connected physically.
	  URL: http://www.microsoft.com/whdc/connect/rally/rallypnpx.mspx

	  If unsure, say N.

config MINIUPNPD_PNPX_HWID
	depends on MINIUPNPD_SUPPORT_PNPX
	string
	prompt "PnP-X HW ID"
	default "VEN_01f2&DEV_8000&REV_04 VEN_0033&DEV_0008&REV_01"
	help
	  For NETGEAR Router, the PnP-X HW ID have 3 parts: [NTGR Specific HW ID] [NTGR Generic HW ID] VEN_0033&DEV_0008&REV_01
	  thereinto, [NTGR Specific HW ID] is assigned by NTGR and each ID is used specifically for a specific model.
	  [NTGR Generic HW ID] For a router product without a USB port, use VEN_01f2&DEV_8000&REV_01; for a router product with
	  a USB port, use VEN_01f2&DEV_8000&SUBSYS_01&REV_01 VEN_01f2&DEV_8000&REV_01.
	  VEN_0033&DEV_0008&REV_01 is Microsoft Specific HW ID for IGD
```

## package/moca-util/Config.in
```kconfig
config MOCA_UTIL_GIT_TREEISH
	string
	prompt "treeish of moca-util git repository"
	default "moca-v1.01-final-dni06"
	help
           Input the treeish of moca-util git repository which you want to build

config MOCA_UTIL_GIT_REPOSITORY
	string
	prompt "name of moca-util git repository"
	default "moca-util.git"
	help
	   Input the name of moca-util git repository which you want to build

config MOCA_UTIL_GIT_URL
	string
	prompt "url of moca-util git repository"
	default "ssh://dniserver/scm/dnigit/common/apps/moca-util.git"
	help
	   Input the url of moca-util git repository which you want to build
```

## package/net-cgi/Config.in
```kconfig
config NET_CGI_GIT_TREEISH
	string
	prompt "treeish of net-cgi git repository"
	default "net-cgi-dni087"
	help
           Input the treeish of net-cgi git repository which you want to build

config NET_CGI_GIT_REPOSITORY
	string
	prompt "name of net-cgi git repository"
	default "net-cgi.git"
	help
	   Input the name of net-cgi git repository which you want to build

config NET_CGI_GIT_URL
	string
	prompt "url of net-cgi git repository"
	default "ssh://dniserver/scm/dnigit/common/apps/net-cgi.git"
	help
	   Input the url of net-cgi git repository which you want to build

config DNI_DEFAULT_CGI_CONFIGURATION
	bool "Use the default configuration file of net-cgi"
	default y

config NET_CGI_PLATFORM_PATCH
	bool "Apply platform specific patches"
	default n

config NET_CGI_PLATFORM_DEFAULT_LANGUAGE
	bool "Use platform default language"
	default n

menuconfig NET_CGI_LANGUAGE_TABLE
	bool "Build language table along with the f/w, so that the fileinfo.txt will update automatically"
	default n

if NET_CGI_LANGUAGE_TABLE

config NET_CGI_LANGUAGE_TABLE_GIT_TREEISH
	string
	depends on NET_CGI_LANGUAGE_TABLE
	prompt "treeish of net-web-language-table git repository"
	default "language_tableV1.0.0.158"
	help
           Input the treeish of net-web-language-table git repository which you want to build

config NET_CGI_LANGUAGE_TABLE_BUILD_OPTION
	string
	depends on NET_CGI_LANGUAGE_TABLE
	prompt "build option of net-web-language-table git repository"
	default TARGET_MODELNAME

config NET_CGI_LANGUAGE_TABLE_GIT_REPOSITORY
	string
	depends on NET_CGI_LANGUAGE_TABLE
	prompt "name of net-web-language-table git repository"
	default "net-web-language-table.git"
	help
	   Input the name of net-web-language-table git repository which you want to build

config NET_CGI_LANGUAGE_TABLE_GIT_URL
	string
	depends on NET_CGI_LANGUAGE_TABLE
	prompt "url of net-web-language-table git repository"
	default "ssh://dniserver/scm/dnigit/common/apps/net-web-language-table.git"
	help
	   Input the url of net-web-language-table git repository which you want to build

comment "Select default local language"
config ENG
	bool "English"
	depends on NET_CGI_LANGUAGE_TABLE
	default y

config GR
	bool "German"
	depends on NET_CGI_LANGUAGE_TABLE
	default y

config PT
	bool "PORTUGAL"
	depends on NET_CGI_LANGUAGE_TABLE
	default y

config RU
	bool "Russia"
	depends on NET_CGI_LANGUAGE_TABLE
	default y
endif
```

## package/net-snmp/Config.in
```kconfig
config NET_SNMP_GIT_TREEISH
	string
	prompt "treeish of net-snmp git repository"
	default "net-snmp-5.0.9-dni7"
	help
           Input the treeish of net-snmp git repository which you want to build

config NET_SNMP_GIT_REPOSITORY
	string
	prompt "name of net-snmp git repository"
	default "net-snmp.git"
	help
	   Input the name of net-snmp git repository which you want to build

config NET_SNMP_GIT_URL
	string
	prompt "url of net-snmp git repository"
	default "ssh://dniserver/scm/dnigit/apps/net-snmp/anderson.deng/net-snmp.git"
	help
	   Input the url of net-snmp git repository which you want to build
```

## package/net6conf/Config.in
```kconfig
config NET6CONF_GIT_TREEISH
	string
	prompt "treeish of net6conf git repository"
	default "net6conf-dni89"
	help
           Input the treeish of net6conf git repository which you want to build

config NET6CONF_GIT_REPOSITORY
	string
	prompt "net6conf git repository"
	default "net6conf.git"
	help
	  Input the name of net6conf git repository which you want to build

config NET6CONF_GIT_URL
	string
	prompt "net6conf git url"
	default "ssh://dniserver/scm/dnigit/common/apps/net6conf.git"
	help
	  Input the url of net6conf git repository which you want to build

config NET6CONF_PLATFORM_PATCH
	bool "Apply platform specific patch"
	default n
	
```

## package/telnetenable/Config.in
```kconfig
config TELNETENABLE_GIT_TREEISH
	string
	prompt "treeish of telnetenable git repository"
	default "telnetenable-dni1"
	help
	  input the treeish of telnetenable git repository which you want to build

config TELNETENABLE_GIT_REPOSITORY
	string
	prompt "name of telnetenable git repository"
	default "telnetenable.git"
	help
	  input the name of telnetenable git repository which you want to build

config TELNETENABLE_GIT_URL
	string
	prompt "url of telnetenable git repository"
	default "ssh://dniserver/scm/dnigit/common/apps/telnetenable.git"
	help
	  input the url of telnetenable git repository which you want to build
```

## package/uhttpd/Config.in
```kconfig
config UHTTPD_GIT_TREEISH
	string
	prompt "treeish of uhttpd git repository"
	default "uhttpd-dni001"
	help
           Input the treeish of uhttpd git repository which you want to build

config UHTTPD_GIT_REPOSITORY
        string
        prompt "name of uhttpd git repository"
        default "uhttpd.git"
        help
           Input the name of uhttpd git repository which you want to build

config UHTTPD_GIT_URL
	string
	prompt "url of uhttpd git repository"
	default "ssh://dniserver/scm/dnigit/common/apps/uhttpd.git"
	help
	  input the url of uhttpd git repository which you want to build

config UHTTPD_PLATFORM_PATCH
	bool "Apply platform specific patches"
	default n

config uhttpd-mod-cgi
	bool "The CGI support to uHTTPd."
	default y

config uhttpd-mod-lua
	bool "The Lua plugin adds a CGI-like Lua runtime interface to uHTTPd."
	default n

config uhttpd-mod-tls_cyassl
	bool "The cyassl TLS plugin adds HTTPS support to uHTTPd."
	default y

config uhttpd-mod-tls_openssl
	bool "The openssl TLS plugin adds HTTPS support to uHTTPd."
	default n
```

## target/linux/brcm5356/Config.in
```kconfig
config TARGET_LINUX_GIT_TREEISH
	string
	prompt "treeish of linux git repository"
	depends on TARGET_brcm5356
	default "Please Input a Valid Treeish"
	help
           Input the treeish of linux git repository which you want to build

config TARGET_LINUX_GIT_REPOSITORY
	string
	prompt "name of linux git repository"
	depends on TARGET_brcm5356
	default "linux-2.6.22.git"
	help
	   Input the name of linux git repository which you want to build

config TARGET_LINUX_GIT_URL
	string
	prompt "url of linux git repository"
	depends on TARGET_brcm5356
	default "ssh://dniserver/scm/dnigit/openwrt-buildroot.git/alime.mao/kernel/linux-2.6.22.git"
	help
	   Input the url of linux git repository which you want to build

config TARGET_NETFILTER_GIT_TREEISH
	string
	prompt "treeish of netfilter git repository"
	depends on TARGET_brcm5356
	default "Please Input a Valid Treeish"
	help
           Input the treeish of netfilter git repository which you want to build

config TARGET_NETFILTER_GIT_REPOSITORY
	string
	prompt "name of netfilter git repository"
	depends on TARGET_brcm5356
	default "dni-netfilter-2.6.22.git"
	help
	   Input the name of netfilter git repository which you want to build

config TARGET_NETFILTER_GIT_URL
	string
	prompt "url of netfilter git repository"
	depends on TARGET_brcm5356
	default "ssh://dniserver/scm/dnigit/openwrt-buildroot.git/alime.mao/kernel/dni-netfilter-2.6.22.git"
	help
	   Input the url of netfilter git repository which you want to build

config LSDK_TREEISH
	string
	prompt "treeish of broadcom lsdk git repository"
	depends on TARGET_brcm5356
	default "Please Input a Valid Treeish"
	help
           Input the treeish of netfilter git repository which you want to build

config LSDK_REPOSITORY
	string
	prompt "name of broadcom lsdk git repository"
	depends on TARGET_brcm5356
	default "broadcom-lsdk.git"
	help
	   Input the name of netfilter git repository which you want to build

config LSDK_URL
	string
	prompt "url of broadcom lsdk git repository"
	depends on TARGET_brcm5356
	default "ssh://dniserver/scm/dnigit/openwrt-buildroot.git/alime.mao/lsdk/broadcom-lsdk.git"
	help
	   Input the url of netfilter git repository which you want to build
```

## target/linux/jndr2210/Config.in
```kconfig
config TARGET_LINUX_GIT_TREEISH
	string
	prompt "treeish of linux git repository"
	depends on TARGET_jndr2210
	default "a879e29dcde6393fe4a67f9059d1c5c8632ab703"
	help
           Input the treeish of linux git repository which you want to build

config TARGET_LINUX_GIT_REPOSITORY
	string
	prompt "name of linux git repository"
	depends on TARGET_jndr2210
	default "linux-2.6.30.git"
	help
	   Input the name of linux git repository which you want to build

config TARGET_LINUX_GIT_URL
	string
	prompt "url of linux git repository"
	depends on TARGET_jndr2210
	default "ssh://dniserver/home/michell.dong/git_home/linux-2.6.30.git"
	help
	   Input the url of linux git repository which you want to build

config TARGET_NETFILTER_GIT_TREEISH
	string
	prompt "treeish of netfilter git repository"
	depends on TARGET_jndr2210
	default "netfilter-v2.6.31-dni13"
	help
           Input the treeish of netfilter git repository which you want to build

config TARGET_NETFILTER_GIT_REPOSITORY
	string
	prompt "name of netfilter git repository"
	depends on TARGET_jndr2210
	default "dni-netfilter.git"
	help
	   Input the name of netfilter git repository which you want to build

config TARGET_NETFILTER_GIT_URL
	string
	prompt "url of netfilter git repository"
	depends on TARGET_jndr2210
	default "ssh://dniserver/scm/dnigit/taipei-clones/dni-netfilter.git"
	help
	   Input the url of netfilter git repository which you want to build
```

## target/linux/jndr2210/image/Config.in
```kconfig
config TARGET_MODELNAME
    string "Define the model name for jndr2210"
    depends TARGET_jndr2210
    default "jndr2210"

config TARGET_BOARD_HW_ID
    string "Define the board hw id for jndr2210"
    depends TARGET_jndr2210
    default "29763754+4+32"

config TARGET_FW_VERSION
    string "Define the firmware version"
    depends TARGET_jndr2210
    default "V1.0.0.5"

config TARGET_LG_VERSION
    string "Define the language table version"
    depends TARGET_jndr2210
    default "V1.0.0.107"
```

## target/linux/r6000d/image/Config.in
```kconfig
config TARGET_MODELNAME
    string "Define the model name for r6000d"
    depends TARGET_r6000d
    default "R6000D"

config TARGET_BOARD_HW_ID
    string "Define the board hw id for r6000d"
    depends TARGET_r6000d
    default "29764037+8+64"

config TARGET_FW_VERSION
    string "Define the firmware version"
    depends TARGET_r6000d
    default "V0.0.0.1"

config TARGET_LG_VERSION
    string "Define the language table version"
    depends TARGET_r6000d
    default "V1.0.0.104"

config TARGET_MAGIC_NUMBER
    string "Define the magic number for the firmware"
    depends TARGET_r6000d
    default "0x36303030"

config TARGET_HEAD_LENGTH
    string "Define the length of r6000d's firmware header."
    depends TARGET_r6000d
    default "128"

config TARGET_KERNEL_SIZE
    string "Define the kernel size of r6000d's firmware"
    depends TARGET_r6000d
    default "1152k"

config TARGET_MAX_KERNEL_SIZE
    string "Define the max kernel size of r6000d's firmware"
    depends TARGET_r6000d
    default "1179648"

config TARGET_MAX_IMAGE_SIZE
    string "Define the max image size of r6000d's firmware"
    depends TARGET_r6000d
    default "25034752"
```

## target/linux/r6100/image/Config.in
```kconfig
config TARGET_MODELNAME
    string "Define the model name for wndr3700v4"
    depends TARGET_r6100
    default "r6100"

config TARGET_BOARD_HW_ID
    string "Define the board hw id for wndr3700v4"
    depends TARGET_r6100
    default "29763754+4+32"

config TARGET_FW_VERSION
    string "Define the firmware version"
    depends TARGET_r6100
    default "V1.0.0.0"

config TARGET_LG_VERSION
    string "Define the language table version"
    depends TARGET_r6100
    default "V1.0.0.107"
```
